/*
 * Copyright (c) 2020 The ZMK Contributors
 *
 * SPDX-License-Identifier: MIT
 */

#include <dt-bindings/pinctrl/nrf-pinctrl.h>
#include "corne_hw.dtsi"


&kscan0 {
    col-gpios = <&gpio0 17  (GPIO_ACTIVE_HIGH | GPIO_PULL_DOWN)>,  /* D6 = P1.00 */
                <&gpio0 20  (GPIO_ACTIVE_HIGH | GPIO_PULL_DOWN)>,  /* D6 = P1.00 */
                <&gpio0 22  (GPIO_ACTIVE_HIGH | GPIO_PULL_DOWN)>,  /* D6 = P1.00 */
                <&gpio0 24  (GPIO_ACTIVE_HIGH | GPIO_PULL_DOWN)>,  /* D6 = P1.00 */
                <&gpio1 0  (GPIO_ACTIVE_HIGH | GPIO_PULL_DOWN)>,  /* D6 = P1.00 */
                <&gpio0 11 (GPIO_ACTIVE_HIGH | GPIO_PULL_DOWN)>;  /* D7 = P0.11 */

    row-gpios = 
                <&gpio0 31  GPIO_ACTIVE_HIGH>,  /* Col 0 = P0.02 */
                <&gpio0 29  GPIO_ACTIVE_HIGH>,  /* Col 0 = P0.02 */
                <&gpio0 2  GPIO_ACTIVE_HIGH>,  /* Col 0 = P0.02 */
                <&gpio1 15 GPIO_ACTIVE_HIGH>,  /* Col 1 = P1.15 */
                <&gpio1 13 GPIO_ACTIVE_HIGH>,  /* Col 2 = P1.13 */
                <&gpio1 11 GPIO_ACTIVE_HIGH>;  /* Col 3 = P1.11 */
};

// pinctrl configuration is handled by the board (Nice Nano)

